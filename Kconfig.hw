## Kconfig.hw
```kconfig
menu "Bluetooth Hardware Config"
    depends on (BF0_LCPU || FPGA || BSP_USING_PC_SIMULATOR || (BF0_HCPU && !SOC_SF32LB55X))
    config ROM_ATT_BUF_SIZE
    int "ATT database size"
    default 3084
    config ROM_LOG_SIZE
        int "Log buffer size"
        default 4096
    choice ROM_ENV_BUFF
        prompt "Select ROM envoirment buffer"
        default BLE_ACTIVITY_6
        depends on SOC_SF32LB55X
        config BLE_ACTIVITY_6
            bool "Conifg maximum 6 links"           
        config BLE_ACTIVITY_2
            bool "Config maximum 2 links"
    endchoice
    menu "STACK_CONFIG"
        depends on (SOC_SF32LB56X || SOC_SF32LB52X) && BF0_LCPU
        menuconfig STACK_BT_ON
            bool "BT classical enable"
            default y
            config MAX_BT_ACL
                int "Supported ACL number. Maximum is 2"
                depends on STACK_BT_ON
                default 2
            config MAX_BT_SCO
                int "Supported SCO number. Maximum is 1"
                depends on STACK_BT_ON
                default 1
        menuconfig STACK_BLE_ON
            bool "BLE enable"
            default y
            config MAX_BLE_ACT
                int "Supported ACL number. Maximum is 10"
                depends on STACK_BLE_ON
                default 6
            config MAX_BLE_RAL
                int "Supported RAL number. Maximum is 6"
                depends on STACK_BLE_ON
                default 3
            config MAX_BLE_ISO
                int "Supported ISO number. Maximum is 2"
                depends on STACK_BLE_ON
                default 2
    endmenu
    choice BTC_RUN_TYPE
        prompt "Config how LCPU run"
        default LCPU_RUN_ROM_COMBINE_RAM
    config LCPU_RUN_ROM_COMBINE_RAM
        bool "LCPU run based on ROM and RAM"
        depends on BF0_HCPU
    config LCPU_RUN_SEPERATE_IMG
        bool "LCPU run based a seperated image on RAM or flash"
        depends on ((SOC_SF32LB58X || SOC_SF32LB56X)&& BF0_HCPU)
    config LCPU_RUN_ROM_ONLY
        bool "LCPU run based on ROM"
        depends on (SOC_SF32LB58X && BF0_HCPU)
    endchoice
    
    choice STACK_ENV_BUFF
        prompt "Select ROM envoirment buffer"
        default BT_DUAL_CTRL_MEM
        depends on (SOC_SF32LB58X || SOC_SF32LB56X || SOC_SF32LB52X)
        config BT_DUAL_FULL_MEM
            bool "Conifg BT dual-mode full memory"
            depends on BF0_LCPU
        config BT_DUAL_CTRL_MEM
            bool "Config BT dual-mode controller memory"
            depends on BF0_LCPU
        config BT_DUAL_HOST_MEM
            bool "Config BT dual-mode host memory"
            depends on BF0_HCPU
    endchoice
    config ROM_LOG_PORT
    string "ROM log port"
    default "uart3"
    depends on SOC_SF32LB55X
    choice
        depends on (SOC_SF32LB58X || SOC_SF32LB56X || SOC_SF32LB52X || BSP_USING_PC_SIMULATOR)
        prompt "Select stack data transfer port"
        default MB_PORT
        config UART_PORT0
            bool "Use UART as transfer port"
            config UART_PORT0_PORT
            depends on UART_PORT0
            string "Choose uart port"
            default "uart3"
        config MB_PORT
            bool "Use HW Mailbox as transfer port"
        config IPC_PORT
            bool "Use IPC as transfer port"
    endchoice
    choice
        prompt "Select trace port"
        depends on ((SOC_SF32LB58X || SOC_SF32LB56X) && BF0_LCPU) || ((SOC_SF32LB52X || SOC_SF32LB56X || SOC_SF32LB58X) && BF0_HCPU)
        default UART_PORT1
        config UART_PORT1
            bool "Use UART as trace port"
            config UART_PORT1_PORT
            depends on UART_PORT1
            string "Choose uart port"
            default "uart4"
        config HCI_ON_FLASH
            bool "Write HCI log to dedicated flash area"
            depends on (SOC_SF32LB52X || SOC_SF32LB56X || SOC_SF32LB58X) && BF0_HCPU
        config HCI_ON_LOG
            bool "Write HCI log to ulog"
            depends on SOC_SF32LB52X || SOC_SF32LB56X || SOC_SF32LB58X
            config LOG_ON_CONSOLE
            bool "Mixed HCI log with system log"
                depends on HCI_ON_LOG
                default n
            config HCI_LOG_SIZE
            int "Mixed HCI Log buffer size"
                depends on HCI_ON_LOG
                default 131072
        config HCI_DISABLE
            bool "Disable bt host HCI log"
    endchoice
    choice BT_IPC_UART_PORT
        prompt "IPC UART PORT"
        default IPC_USE_CONSOLE_DEVICE
        config IPC_USE_CONSOLE_DEVICE
            bool "IPC use console device"
        config IPC_USE_OWN_DEVICE
            bool "IPC use its own device"
            config IPC_OWN_DEVICE_NAME
                string "IPC own device name"
                depends on IPC_USE_OWN_DEVICE
                default "uart2"
    endchoice
endmenu
```

## zephyr_bt/Kconfig.zbt
```kconfig
    
config SEGGER_RTT_MAX_NUM_UP_BUFFERS
    int
    default 8

config UTF8
    bool
    default y    

config LIBLC3
	bool "liblc3 Support"
    default y if ZBT
    default n if !ZBT
	help
	  This option enables the Android liblc3 library for Bluetooth LE Audio            

config BT_HCI_SETUP
	bool
	help
	  Enable the HCI vendor-specific Setup function.

	  This option has to be enabled when the BT Controller requires execution
	  of the vendor-specific commands sequence to initialize the BT Controller
	  before the BT Host executes a Reset sequence.

	  The user should generally avoid changing it via menuconfig or in
	  configuration files. This option are enabled by the vendor-specific
	  HCI extension, where the Setup function is implemented.
      
config BT_HCI_SET_PUBLIC_ADDR
	bool
    default y if ZBT
    default n
	select BT_HCI_SETUP
	help
	  Pass the controller's public address to the HCI driver in setup()

	  This option should be enabled by drivers for controllers that support setting the
	  public identity through vendor-specific commands. They can then implement the
	  setup() HCI driver API function and get the address to set from the public_addr field.

	  From the application side, the public address is set using the first call to
	  bt_id_create(), before calling bt_enable().      
      
```
